#include <WiFi.h>
#include <WebServer.h>
#include <ESPmDNS.h>
#include <Update.h>
#include <Ticker.h>
#include "html.h"
#include <Adafruit_GFX.h>     // Core graphics library
#include <Adafruit_ST7735.h>  // Hardware-specific library for ST7735
#include <SPI.h>

#define TFT_CS 10
#define TFT_RST -1
#define TFT_DC 8
#define TFT_MOSI 7
#define TFT_CLK 6


const uint16_t rick[] = {// 'Unbenannt', 80x80px
0xc5bc, 0xc5bc, 0xc5bc, 0xbdbb, 0xbd9b, 0xbd9b, 0xbd9b, 0xbd9b, 0xbd7b, 0xbd7b, 0xbd7a, 0xbd7b, 0xbd7b, 0xbd7b, 0xbd7a, 0xbd5a, 
0xbd5a, 0xbd7b, 0xc59b, 0xc59b, 0xcddc, 0xce1c, 0xd61c, 0xcdfc, 0xc5bb, 0xc5bb, 0xc5ba, 0xc5db, 0xcdfc, 0xd61c, 0xd61c, 0xd63d, 
0xc559, 0xc559, 0xc57a, 0xc5ba, 0xcddb, 0xc5ba, 0xcddb, 0xc599, 0xcd99, 0xc558, 0xc538, 0xbd17, 0xb4f6, 0xb517, 0xbd38, 0xbd58, 
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0x2944, 0x2123, 0x2123, 0x2103, 0x2102, 0x2102, 0x2102, 0x20e2, 0x20e2, 0x20c1, 0x20e2, 0x20e2, 0x2902, 0x18a1, 0x9431, 0xd619};
Adafruit_ST7735 tft = Adafruit_ST7735(TFT_CS, TFT_DC, 7, 6, TFT_RST);
#define SSID_FORMAT "ImHackedNow"  // 12 chars total
#define PASSWORD "aaaaaaaa"        // generate if remarked

WebServer server(80);
Ticker tkSecond;
uint8_t otaDone = 0;

const char* alphanum = "0123456789!@#$%^&*abcdefghijklmnopqrstuvwxyzABCDEFGHIJKLMNOPQRSTUVWXYZ";
String generatePass(uint8_t str_len) {
  String buff;
  for (int i = 0; i < str_len; i++)
    buff += alphanum[random(strlen(alphanum) - 1)];
  return buff;
}

void apMode() {
  char ssid[13];
  char passwd[11];
  long unsigned int espmac = ESP.getEfuseMac() >> 24;
  snprintf(ssid, 13, SSID_FORMAT);
  snprintf(passwd, 11, PASSWORD);
  WiFi.mode(WIFI_AP);
  WiFi.softAP(ssid, passwd);  // Set up the SoftAP
  MDNS.begin("esp32");
  Serial.printf("AP: %s, PASS: %s\n", ssid, passwd);
}

void handleUpdateEnd() {
  server.sendHeader("Connection", "close");
  if (Update.hasError()) {
    server.send(502, "text/plain", Update.errorString());
  } else {
    server.sendHeader("Refresh", "10");
    server.sendHeader("Location", "/");
    server.send(307);
    ESP.restart();
  }
}

void handleUpdate() {
  size_t fsize = UPDATE_SIZE_UNKNOWN;
  if (server.hasArg("size")) fsize = server.arg("size").toInt();
  HTTPUpload& upload = server.upload();
  if (upload.status == UPLOAD_FILE_START) {
    Serial.printf("Receiving Update: %s, Size: %d\n", upload.filename.c_str(), fsize);
    if (!Update.begin(fsize)) {
      otaDone = 0;
      Update.printError(Serial);
    }
  } else if (upload.status == UPLOAD_FILE_WRITE) {
    if (Update.write(upload.buf, upload.currentSize) != upload.currentSize) {
      Update.printError(Serial);
    } else {
      otaDone = 100 * Update.progress() / Update.size();
    }
  } else if (upload.status == UPLOAD_FILE_END) {
    if (Update.end(true)) {
      Serial.printf("Update Success: %u bytes\nRebooting...\n", upload.totalSize);
    } else {
      Serial.printf("%s\n", Update.errorString());
      otaDone = 0;
    }
  }
}

void webServerInit() {
  server.on(
  "/update", HTTP_POST, []() {
    handleUpdateEnd();
  },
  []() {
    handleUpdate();
  });
  server.on("/favicon.ico", HTTP_GET, []() {
    server.sendHeader("Content-Encoding", "gzip");
    server.send_P(200, "image/x-icon", favicon_ico_gz, favicon_ico_gz_len);
  });
  server.onNotFound([]() {
    server.send(200, "text/html", indexHtml);
  });
  server.begin();
  Serial.printf("Web Server ready at http://esp32.local or http://%s\n", WiFi.softAPIP().toString().c_str());
}

void everySecond() {
  if (otaDone > 1) Serial.printf("ota: %d%%\n", otaDone);
}

void setup() {
  Serial.begin(115200);
  pinMode(18, OUTPUT);
  digitalWrite(18, HIGH);
  pinMode(19, OUTPUT);
  digitalWrite(19, LOW);
  apMode();
  webServerInit();
  tkSecond.attach(1, everySecond);
  tft.initR(INITR_BLACKTAB);
  tft.invertDisplay(true);
  tft.fillScreen(ST77XX_BLACK);
  tft.setCursor(30, 5);
  tft.setTextColor(ST77XX_WHITE, ST77XX_BLACK);
  tft.setTextWrap(true);
  tft.print("ATC1441");
  tft.setCursor(30, 15);
  tft.print("Toothbrush");
  tft.setCursor(30, 25);
  tft.print("Hacking");
  tft.drawRGBBitmap (20, 79, rick,80,80);
}

uint32_t last_update = 0;
void loop() {
  delay(15);
  if (millis() - last_update > 1000) {
    last_update = millis();
    tft.setCursor(30, 35);
    tft.print(millis() / 1000);
    tft.print("       ");
    Serial.printf("Seconds: %i\r\n", millis() / 1000);
  }
  server.handleClient();
}
